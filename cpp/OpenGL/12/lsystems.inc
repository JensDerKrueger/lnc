    LShape {"combined", "[+++A][---B][C]D", {Rule{'A', "GA[A-AGAA]A"}, Rule{'B', "GB[B+BGBB]B"}, Rule{'C', "GGGGGC[[+C]G-C+]C"}}, 30, {0.0f,1.0f,0.0f}},
    LShape {"flower1", "+++F", {Rule{'F', "F[[+FF]G-F+]F"} }, 28, {1.0f,0.0f,0.0f}},
    LShape {"flower2", "F", {Rule{'F', "FBA"}, Rule{'A', "[+FAGA]F-A+"}, Rule{'B', "AG+F-"} }, 45, {0.25f,1.0f,0.0f}},
    LShape {"tardigrade", "F", {Rule{'F', "F-[+F[AGA-A]]A"}, Rule{'A', "-A[AAG-A]+F+G"} }, 50, {1.0f,0.0f,0.0f}},
    LShape {"feather1", "F", {Rule{'F', "GGA"}, Rule{'A', "[+F-AA-]F+A-"} }, 32, {1.0f,0.0f,0.0f}},
    LShape {"feather2", "F", {Rule{'F', "F[F-FGFF+]F"} }, 27, {-1.0f,0.0f,0.0f}},
    LShape {"spirals", "F", {Rule{'F', "--C[F]G"}, Rule{'A', "CACF+A"}, Rule{'B', "FC+GB-B-B"}, Rule{'C', "-FG-C"} }, 95, {1.0f,0.0f,0.0f}},
    LShape {"galaxies", "F", {Rule{'F', "[[-A]]+F"}, Rule{'A', "F-F+AA[F]F-"} }, 84, {1.0f,0.0f,0.0f}},
    LShape {"contellation (hint: use blend and reduce alpha)", "F", {Rule{'F', "F-F+G+B"}, Rule{'A', "AAA+FAG-B"}, Rule{'B', "[F-G]-BB"} }, 42, {1.0f,0.0f,0.0f}},
    LShape {"cloud silhouette", "F", {Rule{'F', "FFA--"}, Rule{'A', "[G[A-]F]-"} }, 18, {1.0f,0.0f,0.0f}},
    LShape {"fur", "F", {Rule{'F', "G-AB-FC+C"}, Rule{'A', "-CABFB"}, Rule{'B', "-[FFC]-A"}, Rule{'C', "[FB]CACC-"} }, 25, {1.0f,0.0f,0.0f}},
    LShape {"mandala (periodic at angles 10+20N)", "F", {Rule{'F', "++F-GF"} }, 50, {1.0f,0.0f,0.0f}},
    LShape {"big circles", "F", {Rule{'F', "GG[+F]F--F"} }, 89, {1.0f,0.0f,0.0f}},
    LShape {"lunge", "F", {Rule{'F', "F--F+F+F"}}, 80, {1.0f,0.0f,0.0f}},
    LShape {"smoke", "F", {Rule{'F', "F---F-GFGF"} }, 45, {1.0f,0.0f,0.0f}},
    LShape {"dragon", "F", {Rule{'F',"F++GFG--F"}}, 60, {1.0f,0.0f,0.0f}},
    LShape {"microchip", "F", {Rule{'F', "++FFF+"}}, 30, {1.0f,0.0f,0.0f}},
    LShape {"hexgrid (bad)", "F", {Rule{'F',"[G+F][G-F]"}}, 60, {1.0f,0.0f,0.0f}},
    LShape {"hexgrid (ok)", "F+F+F+F+F+F", {Rule{'F', "AF"}, Rule{'A', "G[+G-A[G]]-G+"} }, 60, {1.0f,0.0f,0.0f}},
    LShape {"koch curve sym", "F--F--F", {Rule{'F',"F[+F--F+]-F++F-F"}}, 60, {1.0f,0.0f,0.0f}},

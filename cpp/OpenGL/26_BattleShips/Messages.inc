static const std::string gameTitle = "LNC Battleships";

static std::vector<std::string> pairingMessages {
  "Searching for victim",
  "Search boat's cook",
  "Triggering final boss",
  "Hero captain looking for work",
  "Is anyone there? hello",
  "Searching for ez target",
  "Activate Radar"
};

static std::vector<std::string> waitingBoardMessages {
  "Waiting for slow admiral to position fleet",
  "Waiting for looser to get startet",
  "Waiting for other player to finish fleet setup",
  "Heating up barrels",
  "Preparing for battle"
};

static std::vector<std::string> waitingShotMessages {
  "Preparing for other player",
  "Waiting for other admiral",
  "Incoming"
};

static std::vector<std::string> homeTitles {
  "Home",
  "Good",
  "My Fleet"
};

static std::vector<std::string> guestTitles {
  "Guest",
  "Enemy",
  "Evil",
  "Enemy Fleet"
};
